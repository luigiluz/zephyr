## boards/arm/knot_mesh/Kconfig
```kconfig
#
# Code based on nrf52840_pca10059.
# Base commit: b8d3ee8afb49d27c3e0c2aba946629620f3f3dd0
# Edited by KNoT contributors.
#

# Kconfig - KNoT Mesh board configuration
#
# Copyright (c) 2019 CESAR
# Copyright (c) 2018 Nordic Semiconductor ASA
#
# SPDX-License-Identifier: Apache-2.0

if BOARD_KNOT_MESH

config BOARD_ENABLE_DCDC
        bool "Enable DCDC mode"
        select SOC_DCDC_NRF52X
        default y

config BOARD_HAS_NRF5_BOOTLOADER
	bool "Board has nRF5 bootloader"
	default y
	help
	 If selected, applications are linked so that they can be loaded by
	 Nordic nRF5 bootloader.

endif # BOARD_KNOT_MESH
```

## boards/arm/knot_mesh/Kconfig.board
```kconfig
#
# Code based on nrf52840_pca10059.
# Base commit: ef935898d0bb7eb45f464650d79a264b2c3b0e98
# Edited by KNoT contributors.
#

# Kconfig - KNoT Mesh board configuration
#
# Copyright (c) 2019 CESAR
# Copyright (c) 2018 Nordic Semiconductor ASA
#
# SPDX-License-Identifier: Apache-2.0

config  BOARD_KNOT_MESH
	bool "KNOT MESH"
	depends on SOC_NRF52840_QIAA
```

## boards/arm/knot_mesh/knot_mesh_defconfig
```kconfig
#
# Code based on nrf52840_pca10059.
# Base commit: 38d186a878213e6a5863805c98c20bd81cfb2c84
# Edited by KNoT contributors.
#

# Copyright (c) 2019 CESAR
#
# SPDX-License-Identifier: Apache-2.0

CONFIG_ARM=y
CONFIG_SOC_FAMILY_NRF=y
CONFIG_SOC_SERIES_NRF52X=y
CONFIG_SOC_NRF52840_QIAA=y
CONFIG_BOARD_KNOT_MESH=y

# Enable MPU
CONFIG_ARM_MPU=y

# enable GPIO
CONFIG_GPIO=y

# Enable UART driver, needed for CDC ACM
CONFIG_SERIAL=y
CONFIG_UART_0_NRF_UARTE=y
CONFIG_UART_INTERRUPT_DRIVEN=y

# enable console
CONFIG_CONSOLE=y

# additional board options
CONFIG_GPIO_AS_PINRESET=y
CONFIG_NFCT_PINS_AS_GPIOS=y
```

## subsys/bluetooth/services/Kconfig.setup_ot
```kconfig
# Kconfig - GATT OpenThread Setup Service
#
# Copyright (c) 2019, CESAR. All rights reserved.
#
# SPDX-License-Identifier: Apache-2.0
#

menuconfig BT_GATT_OT_SETUP
	bool "Enable GATT OpenThread Setup Service"
	default n
	depends on SETTINGS_OT
```

## subsys/settings/services/Kconfig
```kconfig
if SETTINGS

menu "Settings Services"

source "subsys/settings/services/Kconfig.settings_ot"

endmenu

endif # SETTINGS
```

## subsys/settings/services/Kconfig.settings_ot
```kconfig
# Kconfig - Settings OpenThread Service
#
# Copyright (c) 2019, CESAR. All rights reserved.
#
# SPDX-License-Identifier: Apache-2.0
#

menuconfig SETTINGS_OT
	bool "Enable Settings OpenThread Service"
	default n
	depends on SETTINGS

menuconfig SETTINGS_OT_DEBUG
	bool "Enable debug"
	default n
	depends on SETTINGS_OT && LOG

menuconfig SETTINGS_OT_DEBUG_LEVEL
	int "Define debug level"
	default 4 if SETTINGS_OT_DEBUG
	default 0
	depends on SETTINGS_OT_DEBUG
```
