## CMakeLists.txt
```
# SPDX-License-Identifier: Apache-2.0

cmake_minimum_required(VERSION 3.13.1)
include($ENV{ZEPHYR_BASE}/cmake/app/boilerplate.cmake NO_POLICY_SCOPE)
project(i2c_master)

target_sources(app PRIVATE src/main.c)
```

## prj.conf
```kconfig
# Logging
CONFIG_LOG=y
CONFIG_LOG_IMMEDIATE=n
CONFIG_PRINTK=y

# I2C
CONFIG_I2C=y
CONFIG_I2C_NRFX=y
CONFIG_I2C_0=y
CONFIG_I2C_1=y
```

## nrf52840_pca10056.overlay
```dts
&i2c0 {
	status = "ok";
	sda-pin = <11>;
	scl-pin = <13>;
};
```

## src/main.c
```c
#include <zephyr.h>
#include <device.h>
#include <gpio.h>
#include <i2c.h>

#define I2C_SLV_ADDR 0X08 /* Defines i2c slave address number */

void main(void)
{
	struct device *i2c_dev;

	printk("Executing main function \n");
	u8_t ledState = 1;
	const u8_t *alguma = &ledState;

	char myString[] = "1 \n";
	char stringReceived[20];

	i2c_dev = device_get_binding(DT_NORDIC_NRF_I2C_0_LABEL);
	if (!i2c_dev) {
		printk("I2C: Device driver not found.\n");
		return;
	}

	int64_t last_toggle_time = 0;

	while (1) {
		/* Get current time */
		int64_t current_time = k_uptime_get();

		/* Sends/receives messages every 5 seconds */
		if (current_time - last_toggle_time > 5000) {
			i2c_write(i2c_dev, alguma, sizeof(ledState), I2C_SLV_ADDR);
			/* i2c_read(i2c_dev, stringReceived, sizeof(stringReceived) , I2C_SLV_ADDR); */
			/* printk("Mensagem recebida foi: %s \n", stringReceived); */
			last_toggle_time = current_time;
		}

	}
}
```
